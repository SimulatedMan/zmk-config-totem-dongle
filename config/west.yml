## config/west.yml
```yaml
manifest:
  remotes:
    - name: zmkfirmware
      url-base: https://github.com/zmkfirmware
    - name: caksoylar
      url-base: https://github.com/caksoylar
    - name: joelspadin
      url-base: https://github.com/joelspadin
    - name: urob
      url-base: https://github.com/urob
    - name: ssbb
      url-base: https://github.com/ssbb
  projects:
    - name: zmk
      remote: zmkfirmware
      revision: main
      import: app/west.yml
        # Apply patch to fix child nodes issue
    - name: zephyr
      remote: urob
      revision: v3.5.0+zmk-fixes
      clone-depth: 1
      import:
        name-blocklist:
          - ci-tools
          - hal_altera
          - hal_cypress
          - hal_infineon
          - hal_microchip
          - hal_nxp
          - hal_openisa
          - hal_silabs
          - hal_xtensa
          - hal_st
          - hal_ti
          - loramac-node
          - mcuboot
          - mcumgr
          - net-tools
          - openthread
          - edtt
          - trusted-firmware-m
    - name: zmk-rgbled-widget
      remote: caksoylar
      revision: main
    - name: zmk-locales
      remote: joelspadin
      revision: main
    - name: zmk-adaptive-key
      remote: urob
      revision: main
  self:
    path: config
```
